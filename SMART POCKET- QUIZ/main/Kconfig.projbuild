## SMART POCKET- QUIZ/main/Kconfig.projbuild
```kconfig
menu "Admatic Config"

    config ENABLE_DEBUG_MODE
        bool "Enable Debug Mode"
        help
            If this config item is set, BLE will start on start and physical buttons won't work.

endmenu
```

## mainchain/main/Kconfig.projbuild
```kconfig
menu "Example Configuration"

    config ENABLE_TOUCH_WAKEUP
        bool "Enable touch wake up"
        default y
        help
            This option enables wake up from deep sleep using touch pads
            TOUCH8 and TOUCH9, which correspond to GPIO33 and GPIO32.

    config ENABLE_ULP_TEMPERATURE_WAKEUP
        bool "Enable temperature monitoring by ULP"
        default y
        help
            This option enables wake up from deep sleep using ULP.
            ULP program monitors the on-chip temperature sensor and
            wakes up the chip when the temperature goes outside of
            the window defined by the initial temperature and a threshold
            around it.

endmenu

menu "Example 'GATT SERVER' Config"

    config SET_RAW_ADV_DATA
        bool "Use raw data for advertising packets and scan response data"
        help
            If this config item is set, raw binary data will be used to generate advertising & scan response data.
            This option uses the esp_ble_gap_config_adv_data_raw() and esp_ble_gap_config_scan_rsp_data_raw()
            functions.

            If this config item is unset, advertising & scan response data is provided via a higher-level
            esp_ble_adv_data_t structure. The lower layer will generate the BLE packets. This option has higher
            overhead at runtime.

endmenu
```

## mainchain/sdkconfig.defaults
```kconfig
CONFIG_ESP32_DEFAULT_CPU_FREQ_80=y
CONFIG_ESP32_DEFAULT_CPU_FREQ_MHZ=80
CONFIG_ESP32_ULP_COPROC_ENABLED=y
CONFIG_ESP32_ULP_COPROC_RESERVE_MEM=512
CONFIG_ESP32_TIME_SYSCALL_USE_RTC_FRC1=y
CONFIG_ESP32_RTC_CLK_SRC_INT_RC=y
CONFIG_BOOTLOADER_SKIP_VALIDATE_IN_DEEP_SLEEP=y

# these are copied for GATTS

CONFIG_BT_ENABLED=y
CONFIG_BTDM_CTRL_MODE_BLE_ONLY=y
CONFIG_BTDM_CTRL_MODE_BR_EDR_ONLY=n
CONFIG_BTDM_CTRL_MODE_BTDM=n




# these are copied into it 
#{
#CONFIG_ESP32_ULP_COPROC_ENABLED=y
#CONFIG_ESP32_ULP_COPROC_RESERVE_MEM=512
#CONFIG_BOOTLOADER_SKIP_VALIDATE_IN_DEEP_SLEEP=y
#}

# these were copied as duplicates
#CONFIG_ESP32_RTC_CLK_SRC_INT_RC=y
```
